## sdkconfig.defaults
```kconfig
# ESP32-S3 Target
CONFIG_IDF_TARGET="esp32s3"

# NimBLE BLE Stack (not Bluedroid)
CONFIG_BT_ENABLED=y
CONFIG_BT_NIMBLE_ENABLED=y
CONFIG_BT_BLUEDROID_ENABLED=n

# NimBLE Multi-Role: Allow simultaneous server + client
CONFIG_BT_NIMBLE_MAX_CONNECTIONS=4
CONFIG_BT_NIMBLE_ROLE_CENTRAL=y
CONFIG_BT_NIMBLE_ROLE_PERIPHERAL=y
CONFIG_BT_NIMBLE_ROLE_OBSERVER=y
CONFIG_BT_NIMBLE_ROLE_BROADCASTER=y

# BLE Security
CONFIG_BT_NIMBLE_SM_LEGACY=y
CONFIG_BT_NIMBLE_SM_SC=y

# PSRAM (Waveshare Knob has 8MB)
CONFIG_SPIRAM=y
CONFIG_SPIRAM_MODE_OCT=y

# Encoder uses Waveshare bidi_switch_knob component (not espressif/knob)

# LVGL fonts
CONFIG_LV_FONT_MONTSERRAT_28=y

# --- Flash size + partition layout ---
# The board has 16 MB flash (ESP32-S3R8). Use it: a full OTA-capable partition
# table (partitions.csv) with two 3 MB app slots + a ~9.9 MB filesystem, matching
# the factory table so images stay OTA-compatible across frameworks. This replaces
# the previous default (2 MB flash, single 1 MB app, no OTA).
CONFIG_ESPTOOLPY_FLASHSIZE_16MB=y
CONFIG_PARTITION_TABLE_CUSTOM=y
CONFIG_PARTITION_TABLE_CUSTOM_FILENAME="partitions.csv"

# Keep the binary lean anyway: optimize the whole build for size (-Os) instead
# of the default debug (-Og). Smaller image = faster OTA and more slot headroom.
CONFIG_COMPILER_OPTIMIZATION_SIZE=y

# Don't compile LVGL's bundled examples/demos into the product firmware.
CONFIG_LV_BUILD_EXAMPLES=n
CONFIG_LV_BUILD_DEMOS=n

# Drop LVGL widgets the UI never instantiates. In use (main/): arc, button,
# checkbox, image, label, tileview. Re-enable a line here before using its
# widget in the UI, or the build will fail to link.
CONFIG_LV_USE_ANIMIMG=n
CONFIG_LV_USE_ARCLABEL=n
CONFIG_LV_USE_BAR=n
CONFIG_LV_USE_BUTTONMATRIX=n
CONFIG_LV_USE_CALENDAR=n
CONFIG_LV_USE_CANVAS=n
CONFIG_LV_USE_CHART=n
CONFIG_LV_USE_DROPDOWN=n
CONFIG_LV_USE_IMAGEBUTTON=n
CONFIG_LV_USE_KEYBOARD=n
CONFIG_LV_USE_LED=n
CONFIG_LV_USE_LINE=n
CONFIG_LV_USE_LIST=n
CONFIG_LV_USE_MENU=n
CONFIG_LV_USE_MSGBOX=n
CONFIG_LV_USE_ROLLER=n
CONFIG_LV_USE_SCALE=n
CONFIG_LV_USE_SLIDER=n
CONFIG_LV_USE_SPAN=n
CONFIG_LV_USE_SPINBOX=n
CONFIG_LV_USE_SPINNER=n
CONFIG_LV_USE_SWITCH=n
CONFIG_LV_USE_TABLE=n
CONFIG_LV_USE_TABVIEW=n
CONFIG_LV_USE_TEXTAREA=n
CONFIG_LV_USE_WIN=n
```
